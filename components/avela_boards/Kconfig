## components/avela_clock/Kconfig
```kconfig
menu "Avela clock"

    config AVELA_TIME_ZONE
        string "Time zone (POSIX TZ)"
        default "CET-1CEST,M3.5.0,M10.5.0/3"
        help
            The local time zone with its daylight-saving rule, as a POSIX TZ string. The default is Central
            European Time (Poland). The clock itself is set over the internet (SNTP) once Wi-Fi is joined.

endmenu
```

## components/avela_network/Kconfig
```kconfig
menu "Avela network"

    config AVELA_SETUP_NETWORK_NAME
        string "Setup network name"
        default "Avela-setup"
        help
            Name of the radio's own Wi-Fi setup network, opened when requested from the Wi-Fi setup screen. It
            does not open automatically when the home network is unavailable. Joining it gives access to the setup page.

    config AVELA_SETUP_NETWORK_PASSWORD
        string "Setup network password"
        default "avela_657"
        help
            WPA2 password of the setup network, 8 to 63 characters. Shown on the radio's setup screen and in its
            QR code.

    config AVELA_HOST_NAME
        string "Host name"
        default "avela"
        help
            The radio's name on the home network: DHCP host name and mDNS (http://<name>.local). The default: the
            setup page and the console can save another (Wi-Fi), in force from the next start.

endmenu
```

## components/avela_weather/Kconfig
```kconfig
menu "Avela weather"

    config AVELA_WEATHER
        bool "Weather"
        default y
        help
            The weather screen (a tile in the screen selector) and its section on the setup page: the place, the
            units. Data from Open-Meteo (no API key), over HTTPS, while the radio is on the home network.

    config AVELA_WEATHER_REFRESH_MINUTES
        int "Minutes between updates"
        depends on AVELA_WEATHER
        range 5 120
        default 15

endmenu
```
